#include "skeletyl.dtsi"

// Raspberry Pi Pico (RP2040) - Left side configuration
// UART: TX=GP0, RX=GP1
// Rows: GP6, GP7, GP8, GP9
// Columns: GP14, GP15, GP2, GP3, GP4

&kscan0 {
    row-gpios
        = <&gpio0 6 (GPIO_ACTIVE_HIGH | GPIO_PULL_DOWN)>  // row0 - GP6
        , <&gpio0 7 (GPIO_ACTIVE_HIGH | GPIO_PULL_DOWN)>  // row1 - GP7
        , <&gpio0 8 (GPIO_ACTIVE_HIGH | GPIO_PULL_DOWN)>  // row2 - GP8
        , <&gpio0 9 (GPIO_ACTIVE_HIGH | GPIO_PULL_DOWN)>  // row3 - GP9
        ; 
    col-gpios
        = <&gpio0 14 (GPIO_ACTIVE_HIGH)> // col0 - GP14
        , <&gpio0 15 (GPIO_ACTIVE_HIGH)> // col1 - GP15
        , <&gpio0 2 (GPIO_ACTIVE_HIGH)>  // col2 - GP2
        , <&gpio0 3 (GPIO_ACTIVE_HIGH)>  // col3 - GP3
        , <&gpio0 4 (GPIO_ACTIVE_HIGH)>  // col4 - GP4
        ;
};

// Configure UART for wired split communication
&uart0 {
    status = "okay";
    current-speed = <115200>;
    pinctrl-0 = <&uart0_default>;
    pinctrl-names = "default";
};
